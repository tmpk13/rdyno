## boards/esp32c3/new_project/sdkconfig.defaults
```kconfig
# Rust needs a larger main task stack than the default 3K
CONFIG_ESP_MAIN_TASK_STACK_SIZE=8192

# These are also a bit too small by default
CONFIG_ESP_SYSTEM_EVENT_TASK_STACK_SIZE=4096
CONFIG_FREERTOS_IDLE_TASK_STACKSIZE=4096

# Increase if you spawn Rust threads that allocate large stack variables
# or use std::thread::Builder::new().stack_size(XXX) instead
CONFIG_PTHREAD_TASK_STACK_SIZE_DEFAULT=4096
```
